## tests/source_header_check/valid/sample.yaml
```yaml
#==============================================================================
# Copyright (c) 2026 KritvaOS
# SPDX-License-Identifier: Apache-2.0
#
# File        : sample.yaml
# Description : Valid configuration sample
#
# Component   : Infrastructure
# Module      : Configuration
# Layer       : Development
#
# Author      : KritvaOS Team
# Created     : 26-09-2026
#==============================================================================
sample: true
```
